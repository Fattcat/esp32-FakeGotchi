// here will be code for that ...
// and I will add some IMGs for show status about which stage esp32 doing and what it doing or with custom icons to indicate.

#include <Wire.h>
#include <Adafruit_GFX.h>
#include <Adafruit_SSD1306.h>
#include <WiFi.h>

#define SCREEN_WIDTH 128  // Šírka displeja OLED
#define SCREEN_HEIGHT 64  // Výška displeja OLED
#define OLED_RESET    -1  // Reset pin pre OLED displej
Adafruit_SSD1306 display(SCREEN_WIDTH, SCREEN_HEIGHT, &Wire, OLED_RESET);

const unsigned char KittyMainIMG[] PROGMEM = {
	0x00, 0x00, 0x03, 0xff, 0xff, 0xff, 0xff, 0xff, 0xff, 0xff, 0xff, 0xff, 0xff, 0xff, 0x80, 0x00, 
	0x00, 0x00, 0x07, 0xff, 0xff, 0xff, 0xff, 0xff, 0xff, 0xff, 0xff, 0xff, 0xff, 0xff, 0xc0, 0x00, 
	0x00, 0x00, 0x03, 0xff, 0xff, 0xff, 0xff, 0xff, 0xff, 0xff, 0xf9, 0xff, 0xff, 0xfe, 0x60, 0x00, 
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	0xff, 0xfe, 0x00, 0x00, 0x00, 0x00, 0x01, 0xfe, 0xfe, 0x7f, 0x00, 0x00, 0x00, 0x00, 0x00, 0x00
}

const unsigned char bitmap_display [] PROGMEM = {
  // Vložiť bitmapu 02 pre zobrazovanie výsledkov
  0x00, 0x00, 0x3C, 0x42, /* ... pokračovanie ... */
};

unsigned long previousMillis = 0;  // Pre sledovanie času
const long interval = 10000;       // 10 sekúnd

void setup() {
  Serial.begin(115200);
  WiFi.mode(WIFI_STA);
  WiFi.disconnect();

  if(!display.begin(SSD1306_SWITCHCAPVCC, 0x3C)) { 
    Serial.println(F("OLED inicializácia zlyhala"));
    for(;;);
  }
  
  display.clearDisplay();
}

void loop() {
  unsigned long currentMillis = millis();

  // Skontrolujte, či uplynulo 10 sekúnd
  if (currentMillis - previousMillis >= interval) {
    previousMillis = currentMillis;

    // Zobrazenie bitmapy pre skenovanie (Bitmap01)
    display.clearDisplay();
    display.drawBitmap(0, 0, KittyMainIMG, 128, 64, SSD1306_WHITE);
    display.display();

    // Skenovanie WiFi sietí
    int n = WiFi.scanNetworks();
    if (n == 0) {
      Serial.println("Žiadne WiFi siete nenájdené");
    } else {
      int strongestSignal = -100;  // Štandardná hodnota pre veľmi slabý signál
      String strongestSSID = "";

      // Nájdeme najsilnejšiu sieť
      for (int i = 0; i < n; ++i) {
        int signalStrength = WiFi.RSSI(i);
        String ssid = WiFi.SSID(i);
        if (signalStrength > strongestSignal) {
          strongestSignal = signalStrength;
          strongestSSID = ssid;
        }
      }

      // Zobrazenie bitmapy pre výsledok (Bitmap02)
      display.clearDisplay();
      display.drawBitmap(0, 0, bitmap_display, 128, 64, SSD1306_WHITE);
      display.display();

      // Vypíše najsilnejšiu WiFi sieť do Serial Monitora
      Serial.print("Najsilejšia sieť: ");
      Serial.print(strongestSSID);
      Serial.print(" s RSSI: ");
      Serial.println(strongestSignal);
    }

    // Odstránenie výsledkov skenovania pre ďalšie použitie
    WiFi.scanDelete();
  }
}
